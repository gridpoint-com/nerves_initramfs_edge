## builder/configs/nerves_initramfs_edge_defconfig
```kconfig
BR2_arm=y
BR2_cortex_a5=y
BR2_ARM_ENABLE_NEON=y
BR2_ARM_ENABLE_VFP=y
BR2_ARM_INSTRUCTIONS+THUMB2=y
BR2_TOOLCHAIN_EXTERNAL=y
BR2_TOOLCHAIN_EXTERNAL_CUSTOM=y
BR2_TOOLCHAIN_EXTERNAL_DOWNLOAD=y
BR2_TOOLCHAIN_EXTERNAL_URL="https://github.com/nerves-project/toolchains/releases/download/v14.2.0/nerves_toolchain_armv7_nerves_linux_gnueabihf-$(shell uname -s)_$(shell uname -m)-14.2.0-6442318.tar.xz"
BR2_TOOLCHAIN_EXTERNAL_CUSTOM_PREFIX="armv7-nerves-linux-gnueabihf"
BR2_TOOLCHAIN_EXTERNAL_HEADERS_5_4=y
BR2_TOOLCHAIN_EXTERNAL_CUSTOM_GLIBC=y
# BR2_TOOLCHAIN_EXTERNAL_INET_RPC is not set
BR2_TOOLCHAIN_EXTERNAL_CXX=y
BR2_TOOLCHAIN_EXTERNAL_FORTRAN=y
BR2_TOOLCHAIN_EXTERNAL_OPENMP=y
BR2_GLOBAL_PATCH_DIR="${BR2_EXTERNAL_CUSTOM_PATH}/patches"
BR2_REPRODUCIBLE=y
BR2_INIT_NONE=y
# BR2_TARGET_ENABLE_ROOT_LOGIN is not set
# BR2_TARGET_GENERIC_GETTY is not set
BR2_ROOTFS_POST_BUILD_SCRIPT="${BR2_EXTERNAL_CUSTOM_PATH}/board/nerves_initramfs/post-build.sh ${BR2_EXTERNAL_CUSTOM_PATH}/board/nerves_initramfs_edge/post-build.sh"
BR2_ROOTFS_POST_SCRIPT_ARGS="nerves_initramfs_edge.conf"
BR2_PACKAGE_BUSYBOX_CONFIG="${BR2_EXTERNAL}/busybox/busybox.config"
BR2_PACKAGE_E2FSPROGS=y
BR2_PACKAGE_FWUP=y
BR2_PACKAGE_READLINE=y
# BR2_PACKAGE_IFUPDOWN_SCRIPTS is not set
BR2_TARGET_ROOTFS_CPIO=y
BR2_TARGET_ROOTFS_CPIO_XZ=y
BR2_TARGET_ROOTFS_CPIO_UIMAGE=y
# BR2_TARGET_ROOTFS_TAR is not set
BR2_PACKAGE_NERVES_INITRAMFS=y
```
